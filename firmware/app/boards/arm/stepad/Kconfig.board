## firmware/app/boards/arm/stepad/Kconfig.board
```kconfig
# Copyright (c) 2021 Yonatan Schachter
# SPDX-License-Identifier: Apache-2.0

config BOARD_STEPAD
	bool "STEPAD Board"
	depends on SOC_RP2040
```
